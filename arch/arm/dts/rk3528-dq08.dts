/*
 * SPDX-License-Identifier:     GPL-2.0+
 *
 * (C) Copyright 2020 Rockchip Electronics Co., Ltd
 */

/dts-v1/;
#include "rk3528.dtsi"
#include "rk3528-u-boot.dtsi"
#include "rk3528-usb.dtsi"
#include "rk3528-gmac0.dtsi"
#include <dt-bindings/input/input.h>

/ {
    model = "Rockchip RK3528 DQ08 TV-Box";
    compatible = "rockchip,rk3528-box", "rockchip,rk3528";
};
