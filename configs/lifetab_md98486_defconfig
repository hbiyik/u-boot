## configs/lifetab_md98486_defconfig
```kconfig
CONFIG_ARM=y
CONFIG_SKIP_LOWLEVEL_INIT_ONLY=y
CONFIG_SPL_SKIP_LOWLEVEL_INIT_ONLY=y
# CONFIG_SPL_USE_ARCH_MEMCPY is not set
# CONFIG_SPL_USE_ARCH_MEMSET is not set
CONFIG_ARCH_ROCKCHIP=y
CONFIG_TEXT_BASE=0x60408000
CONFIG_SYS_MALLOC_F_LEN=0x2000
CONFIG_ENV_SOURCE_FILE="lifetab_md98486"
CONFIG_NR_DRAM_BANKS=1
CONFIG_HAS_CUSTOM_SYS_INIT_SP_ADDR=y
CONFIG_CUSTOM_SYS_INIT_SP_ADDR=0x78000000
CONFIG_SF_DEFAULT_SPEED=20000000
CONFIG_ENV_SIZE=0xFC000
# CONFIG_SPL_DM_SPI is not set
CONFIG_DEFAULT_DEVICE_TREE="rockchip/rk3066a-mk808"
CONFIG_DM_RESET=y
CONFIG_ROCKCHIP_RK3066=y
CONFIG_ROCKCHIP_EXTERNAL_TPL=y
# CONFIG_ROCKCHIP_STIMER is not set
# CONFIG_SPL_MMC is not set
CONFIG_TARGET_MK808=y
CONFIG_SPL_STACK_R_ADDR=0x70000000
CONFIG_SPL_SYS_MALLOC_F_LEN=0x8000
CONFIG_SPL_TEXT_BASE=0x60000000
CONFIG_SPL_STACK_R=y
CONFIG_SPL_STACK_R_MALLOC_SIMPLE_LEN=0x900000
CONFIG_SYS_LOAD_ADDR=0x70800800
CONFIG_DEBUG_UART_BASE=0x20064000
CONFIG_DEBUG_UART_CLOCK=24000000
CONFIG_DEBUG_UART=y
CONFIG_PHYS_64BIT=y
# CONFIG_SPL_BOOTSTD is not set
CONFIG_SD_BOOT=y
CONFIG_AUTOBOOT_MENU_SHOW=y
CONFIG_USE_PREBOOT=y
CONFIG_DEFAULT_FDT_FILE="rockchip/rk3066a-mk808.dtb"
CONFIG_SYS_CBSIZE=256
CONFIG_SYS_PBSIZE=276
CONFIG_LOGLEVEL=8
# CONFIG_DISPLAY_CPUINFO is not set
CONFIG_DISPLAY_BOARDINFO_LATE=y
CONFIG_BOARD_LATE_INIT=y
CONFIG_SPL_MAX_SIZE=0x32000
CONFIG_SPL_NO_BSS_LIMIT=y
# CONFIG_SPL_RAW_IMAGE_SUPPORT is not set
CONFIG_SPL_LEGACY_IMAGE_CRC_CHECK=y
# CONFIG_SPL_SHARES_INIT_SP_ADDR is not set
CONFIG_SPL_NAND_SUPPORT=y
CONFIG_SPL_NAND_DRIVERS=y
CONFIG_SPL_NAND_RO=y
CONFIG_SPL_UBI=y
CONFIG_SPL_UBI_MTD=y
CONFIG_SPL_UBI_MTD_NAME="ubi"
CONFIG_SPL_UBI_MAX_VOL_LEBS=8
CONFIG_SPL_UBI_MAX_PEB_SIZE=1048576
CONFIG_SPL_UBI_MAX_PEBS=8184
CONFIG_SPL_UBI_PEB_OFFSET=0
CONFIG_SPL_UBI_VID_OFFSET=8192
CONFIG_SPL_UBI_LEB_START=16384
CONFIG_SPL_UBI_INFO_ADDR=0x70800800
CONFIG_SPL_UBI_VOL_IDS=4
CONFIG_SPL_UBI_LOAD_MONITOR_ID=0
CONFIG_VPL=y
CONFIG_VPL_RAW_IMAGE_SUPPORT=y
CONFIG_VPL_ENV_SUPPORT=y
# CONFIG_VPL_MMC is not set
# CONFIG_VPL_DM_MMC is not set
CONFIG_VPL_TEXT_BASE=0x60000000
CONFIG_CMD_UFETCH=y
# CONFIG_BOOTM_PLAN9 is not set
# CONFIG_BOOTM_RTEMS is not set
# CONFIG_BOOTM_VXWORKS is not set
CONFIG_CMD_BOOTMENU=y
CONFIG_CMD_ASKENV=y
CONFIG_CMD_CLK=y
CONFIG_CMD_DFU=y
CONFIG_CMD_LSBLK=y
CONFIG_CMD_MTD=y
CONFIG_CMD_MTD_OTP=y
CONFIG_CMD_MTD_MARKBAD=y
CONFIG_CMD_MTD_NAND_WRITE_TEST=y
CONFIG_CMD_MTD_NAND_READ_TEST=y
CONFIG_CMD_NAND_TORTURE=y
CONFIG_CMD_NAND_WATCH=y
CONFIG_CMD_READ=y
CONFIG_CMD_SDRAM=y
# CONFIG_CMD_SF is not set
CONFIG_CMD_USB=y
CONFIG_CMD_RKMTD=y
CONFIG_CMD_ROCKUSB=y
CONFIG_CMD_WRITE=y
# CONFIG_CMD_SETEXPR is not set
CONFIG_CMD_CACHE=y
CONFIG_CMD_TIME=y
CONFIG_CMD_SYSBOOT=y
CONFIG_CMD_REGULATOR=y
CONFIG_CMD_UBI=y
CONFIG_CMD_UBI_RENAME=y
CONFIG_MAC_PARTITION=y
# CONFIG_SPL_MAC_PARTITION is not set
CONFIG_TEGRA_PARTITION=y
# CONFIG_SPL_DOS_PARTITION is not set
CONFIG_AMIGA_PARTITION=y
# CONFIG_SPL_AMIGA_PARTITION is not set
# CONFIG_SPL_EFI_PARTITION is not set
CONFIG_SPL_OF_CONTROL=y
CONFIG_OF_SPL_REMOVE_PROPS=""
CONFIG_ENV_IS_IN_UBI=y
CONFIG_ENV_UBI_PART="ubi"
CONFIG_ENV_UBI_VOLUME="env"
CONFIG_ENV_RELOC_GD_ENV_ADDR=y
CONFIG_NO_NET=y
CONFIG_REGMAP=y
CONFIG_SPL_REGMAP=y
CONFIG_VPL_REGMAP=y
CONFIG_SYSCON=y
CONFIG_SPL_SYSCON=y
CONFIG_VPL_SYSCON=y
# CONFIG_SIMPLE_BUS is not set
CONFIG_SYS_64BIT_LBA=y
CONFIG_CLK=y
CONFIG_SPL_CLK=y
CONFIG_VPL_CLK=y
CONFIG_DFU_RAM=y
CONFIG_DFU_UBI=y
CONFIG_DFU_RKMTD=y
CONFIG_SYS_DFU_DATA_BUF_SIZE=0x1000
CONFIG_FASTBOOT_BUF_ADDR=0x80000000
CONFIG_ROCKCHIP_GPIO=y
# CONFIG_SPL_DM_I2C is not set
CONFIG_LED=y
CONFIG_LED_GPIO=y
CONFIG_MMC_IO_VOLTAGE=y
CONFIG_MMC_UHS_SUPPORT=y
CONFIG_MMC_DW=y
CONFIG_MMC_DW_ROCKCHIP=y
CONFIG_MTD_RAW_NAND=y
CONFIG_SYS_MAX_NAND_DEVICE=4
CONFIG_SYS_NAND_DRIVER_ECC_LAYOUT=y
CONFIG_SYS_NAND_USE_FLASH_BBT=y
CONFIG_ROCKCHIP_NAND=y
# CONFIG_SPL_ROCKCHIP_NAND_CLOCKS is not set
# CONFIG_ROCKCHIP_NAND_V8 is not set
# CONFIG_ROCKCHIP_NAND_V9 is not set
CONFIG_SYS_NAND_BLOCK_SIZE=0x100000
# CONFIG_NAND_CHIP_IDS is not set
# CONFIG_NAND_CHIP_TOSHIBA is not set
# CONFIG_NAND_CHIP_SAMSUNG is not set
# CONFIG_NAND_CHIP_HYNIX is not set
# CONFIG_NAND_CHIP_AMD is not set
# CONFIG_NAND_CHIP_MACRONIX is not set
# CONFIG_NAND_TIMINGS is not set
CONFIG_SYS_NAND_MAX_CHIPS=4
# CONFIG_UBI_SILENCE_MSG is not set
CONFIG_MTD_UBI_FASTMAP=y
CONFIG_MTD_UBI_FASTMAP_AUTOCONVERT=1
CONFIG_PINCTRL=y
CONFIG_SPL_PINCTRL=y
# CONFIG_SPL_PINMUX is not set
CONFIG_DM_PMIC=y
# CONFIG_SPL_PMIC_CHILDREN is not set
CONFIG_DM_REGULATOR_FIXED=y
CONFIG_DM_REGULATOR_GPIO=y
CONFIG_RAM=y
CONFIG_SPL_RAM=y
CONFIG_VPL_RAM=y
# CONFIG_REQUIRE_SERIAL_CONSOLE is not set
CONFIG_DEBUG_UART_SHIFT=2
CONFIG_SYS_NS16550_MEM32=y
CONFIG_ROCKCHIP_SERIAL=y
CONFIG_SYSRESET=y
CONFIG_VPL_SYSRESET=y
CONFIG_TIMER=y
CONFIG_SPL_TIMER=y
CONFIG_VPL_TIMER=y
CONFIG_DESIGNWARE_APB_TIMER=y
CONFIG_USB=y
# CONFIG_SPL_DM_USB is not set
CONFIG_VPL_DM_USB=y
CONFIG_VPL_DM_USB_GADGET=y
CONFIG_USB_DWC2=y
CONFIG_ROCKCHIP_USB2_PHY=y
# CONFIG_USB_STORAGE is not set
CONFIG_USB_GADGET=y
CONFIG_SPL_USB_GADGET=y
CONFIG_VPL_USB_GADGET=y
CONFIG_USB_GADGET_DWC2_OTG=y
CONFIG_USB_FUNCTION_ROCKUSB=y
CONFIG_VPL_DFU=y
CONFIG_FS_BTRFS=y
CONFIG_FS_CBFS=y
CONFIG_SPL_FS_CBFS=y
# CONFIG_UBIFS_SILENCE_MSG is not set
CONFIG_FS_SQUASHFS=y
CONFIG_VPL_USE_TINY_PRINTF=y
CONFIG_SPL_TINY_MEMSET=y
# CONFIG_SPL_SHA1 is not set
# CONFIG_SPL_SHA256 is not set
# CONFIG_VPL_SHA1 is not set
# CONFIG_VPL_SHA256 is not set
CONFIG_ERRNO_STR=y
CONFIG_TPL_OF_LIBFDT=y
```
